#include "oled.h"
#include "i2c.h"
#include <stdarg.h>
#include <stdio.h>
#include <string.h>

/* OLED 显存缓冲区: 128×64 = 1024 字节 */
static uint8_t OLED_Buffer[OLED_WIDTH * OLED_HEIGHT / 8];

/*
 * 6×8 像素 ASCII 字库 (空格 ~ 波浪号)
 * 每个字符占 6 字节, 每字节对应一列 (8 像素/列, LSB 在上)
 */
static const uint8_t Font6x8[][6] = {
    {0x00,0x00,0x00,0x00,0x00,0x00},
    {0x00,0x00,0x5F,0x00,0x00,0x00},
    {0x00,0x07,0x00,0x07,0x00,0x00},
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    {0x08,0x04,0x08,0x10,0x08,0x00},
};

/*
 * 8×16 像素 ASCII 字库 (空格 ~ 波浪号)
 * 每个字符占 16 字节: 前 8 字节 = 上半部分, 后 8 字节 = 下半部分
 */
static const uint8_t Font8x16[][16] = {
    {0x00,0x00,0x00,0x00,0x00,0x00,0x00,0x00,0x00,0x00,0x00,0x00,0x00,0x00,0x00,0x00},
    {0x00,0x00,0x00,0xF8,0x00,0x00,0x00,0x00,0x00,0x00,0x00,0x33,0x30,0x00,0x00,0x00},
    {0x00,0x10,0x0C,0x06,0x10,0x0C,0x06,0x00,0x00,0x00,0x00,0x00,0x00,0x00,0x00,0x00},
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    {0x00,0x00,0x00,0x00,0x00,0x00,0x00,0x00,0x00,0x00,0x00,0x00,0x00,0x00,0x00,0x00},
    /* a (0x61) */
    {0x00,0x00,0x20,0x54,0x54,0x54,0x78,0x00,0x00,0x00,0x20,0x20,0x20,0x20,0x00,0x00},
    {0x00,0x00,0x7E,0x08,0x04,0x04,0x08,0x00,0x00,0x00,0x0E,0x11,0x11,0x0E,0x00,0x00},
    {0x00,0x00,0x7C,0x08,0x04,0x04,0x08,0x00,0x00,0x00,0x0E,0x11,0x11,0x0E,0x00,0x00},
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    {0x08,0x04,0x08,0x10,0x08,0x00,0x00,0x00,0x00,0x00,0x00,0x00,0x00,0x00,0x00,0x00},
};

static void OLED_WriteCmd(uint8_t cmd)
{
    HAL_I2C_Mem_Write(&OLED_I2C, OLED_ADDR << 1, SSD1306_CMD, 1, &cmd, 1, 100);
}

static void OLED_WriteData(uint8_t data)
{
    HAL_I2C_Mem_Write(&OLED_I2C, OLED_ADDR << 1, SSD1306_DATA, 1, &data, 1, 100);
}

void OLED_SendCmd(uint8_t cmd)
{
    OLED_WriteCmd(cmd);
}

void OLED_SendData(uint8_t data)
{
    OLED_WriteData(data);
}

void OLED_SetCursor(uint8_t x, uint8_t y)
{
    OLED_WriteCmd(0xB0 + y);
    OLED_WriteCmd(((x & 0xF0) >> 4) | 0x10);
    OLED_WriteCmd(x & 0x0F);
}

void OLED_Clear(void)
{
    memset(OLED_Buffer, 0x00, sizeof(OLED_Buffer));
    /* 注意: 不调用 OLED_Display() — 由 Display_Update 统一刷新 */
}

void OLED_Display(void)
{
    for (uint8_t page = 0; page < 8; page++)
    {
        OLED_WriteCmd(0xB0 + page);
        OLED_WriteCmd(0x00);
        OLED_WriteCmd(0x10);
        for (uint8_t col = 0; col < OLED_WIDTH; col++)
        {
            OLED_WriteData(OLED_Buffer[page * OLED_WIDTH + col]);
        }
    }
}

static void OLED_DrawPoint(uint8_t x, uint8_t y, uint8_t color)
{
    if (x >= OLED_WIDTH || y >= OLED_HEIGHT) return;
    if (color)
        OLED_Buffer[x + (y / 8) * OLED_WIDTH] |= (1 << (y % 8));
    else
        OLED_Buffer[x + (y / 8) * OLED_WIDTH] &= ~(1 << (y % 8));
}

void OLED_ShowChar(uint8_t x, uint8_t y, char ch, uint8_t size)
{
    if (size == 6)
    {
        if (ch < ' ') ch = ' ';
        uint8_t idx = ch - ' ';
        if (idx >= sizeof(Font6x8) / 6) idx = 0;
        for (uint8_t i = 0; i < 6; i++)
        {
            uint8_t line = Font6x8[idx][i];
            for (uint8_t j = 0; j < 8; j++)
            {
                OLED_DrawPoint(x + i, y + j, (line >> j) & 1);
            }
        }
    }
    else if (size == 8)
    {
        if (ch < ' ') ch = ' ';
        uint8_t idx = ch - ' ';
        if (idx >= sizeof(Font8x16) / 16) idx = 0;
        for (uint8_t i = 0; i < 8; i++)
        {
            uint8_t line1 = Font8x16[idx][i];
            uint8_t line2 = Font8x16[idx][i + 8];
            for (uint8_t j = 0; j < 8; j++)
            {
                OLED_DrawPoint(x + i, y + j, (line1 >> j) & 1);
                OLED_DrawPoint(x + i, y + 8 + j, (line2 >> j) & 1);
            }
        }
    }
}

void OLED_ShowString(uint8_t x, uint8_t y, const char* str, uint8_t size)
{
    while (*str)
    {
        OLED_ShowChar(x, y, *str, size);
        x += size;
        str++;
        if (x + size > OLED_WIDTH)
        {
            x = 0;
            y += (size == 6) ? 8 : 16;
        }
    }
}

void OLED_ShowNum(uint8_t x, uint8_t y, int32_t num, uint8_t len, uint8_t size)
{
    char buf[12];
    snprintf(buf, sizeof(buf), "%*ld", len, (long)num);
    OLED_ShowString(x, y, buf, size);
}

void OLED_ShowFloat(uint8_t x, uint8_t y, float num, uint8_t intLen, uint8_t decLen, uint8_t size)
{
    char buf[16];
    snprintf(buf, sizeof(buf), "%*.*f", intLen + decLen + 1, decLen, num);
    OLED_ShowString(x, y, buf, size);
}

void OLED_Printf(uint8_t x, uint8_t y, const char* fmt, ...)
{
    char buf[32];
    va_list args;
    va_start(args, fmt);
    vsnprintf(buf, sizeof(buf), fmt, args);
    va_end(args);
    OLED_ShowString(x, y, buf, 6);
}

/**
 * SSD1306 OLED 初始化序列
 * 按数据手册要求配置: 关闭显示 → 设置参数 → 开启显示
 */
void OLED_Init(void)
{
    HAL_Delay(100);  /* 等待 SSD1306 上电稳定 */

    OLED_WriteCmd(0xAE); /* 关闭显示 */
    OLED_WriteCmd(0x20); OLED_WriteCmd(0x00); /* 水平寻址模式 */
    OLED_WriteCmd(0xB0); /* 起始页地址 */
    OLED_WriteCmd(0xC8); /* 扫描方向: 从 COM[N-1] 到 COM0 */
    OLED_WriteCmd(0x00); /* 列低地址 */
    OLED_WriteCmd(0x10); /* 列高地址 */
    OLED_WriteCmd(0x40); /* 显示起始行 = 0 */
    OLED_WriteCmd(0x81); OLED_WriteCmd(0xFF); /* 对比度最大 */
    OLED_WriteCmd(0xA1); /* 段重映射: 列127 → SEG0 */
    OLED_WriteCmd(0xA6); /* 正常显示 (非反色) */
    OLED_WriteCmd(0xA8); OLED_WriteCmd(0x3F); /* 多路复用比 = 64 */
    OLED_WriteCmd(0xA4); /* 全局显示: 跟随 RAM 内容 */
    OLED_WriteCmd(0xD3); OLED_WriteCmd(0x00); /* 显示偏移 = 0 */
    OLED_WriteCmd(0xD5); OLED_WriteCmd(0xF0); /* 振荡频率 */
    OLED_WriteCmd(0xD9); OLED_WriteCmd(0x22); /* 预充电周期 */
    OLED_WriteCmd(0xDA); OLED_WriteCmd(0x12); /* COM 引脚配置 */
    OLED_WriteCmd(0xDB); OLED_WriteCmd(0x20); /* VCOMH 电压 */
    OLED_WriteCmd(0x8D); OLED_WriteCmd(0x14); /* 电荷泵使能 */
    OLED_WriteCmd(0xAF); /* 开启显示 */

    OLED_Clear();
}
